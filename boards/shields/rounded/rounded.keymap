/*
 * Copyright (c) 2024
 * SPDX-License-Identifier: MIT
 */

#include <behaviors.dtsi>
#include <dt-bindings/zmk/keys.h>
#include <dt-bindings/zmk/bt.h>
#include <dt-bindings/zmk/outputs.h>

/ {
    keymap {
        compatible = "zmk,keymap";

        default_layer {
            // This is a dongle - no physical keys
            // The matrix transform expects at least one key
            bindings = <&none>;
        };
    };
};