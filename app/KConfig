## app/KConfig
```kconfig
# ZMK Round Display Status Module Configuration

config ROUND_DISPLAY_STATUS
    bool "Enable Round Display Status Module"
    depends on ZMK_DISPLAY && LVGL
    default n
    help
      Enable custom status display module for round displays.
      Shows Hello World, battery status, and BLE connection info
      optimized for 240x240 circular displays.

if ROUND_DISPLAY_STATUS

config ROUND_DISPLAY_UPDATE_INTERVAL
    int "Display update interval in seconds"
    default 5
    help
      How often to update the display content in seconds.
      Lower values provide more responsive updates but use more power.

config ROUND_DISPLAY_REFRESH_RATE
    int "Display refresh rate in milliseconds"
    default 50
    help
      How often to refresh the LVGL display in milliseconds.
      50ms = 20 FPS. Lower values are smoother but use more power.

endif
```

## boards/shields/lily58/Kconfig.defconfig
```kconfig
if SHIELD_LILY58_LEFT || SHIELD_LILY58_DONGLE_XIAO || SHIELD_LILY58_DONGLE_PRO_MICRO

config ZMK_KEYBOARD_NAME
    default "Lily58"

config ZMK_SPLIT_ROLE_CENTRAL
    default y

endif

if SHIELD_LILY58_LEFT || SHIELD_LILY58_RIGHT || SHIELD_LILY58_LEFT_PERIPHERAL || SHIELD_LILY58_DONGLE_XIAO || SHIELD_LILY58_DONGLE_PRO_MICRO

config ZMK_SPLIT
    default y

endif
```

## boards/shields/lily58/Kconfig.shield
```kconfig
config SHIELD_LILY58_LEFT
    def_bool $(shields_list_contains,lily58_left)

config SHIELD_LILY58_RIGHT
    def_bool $(shields_list_contains,lily58_right)

config SHIELD_LILY58_DONGLE_XIAO
    def_bool $(shields_list_contains,lily58_dongle_xiao)
```

## boards/shields/lily58_round_display/Kconfig.defconfig
```kconfig
# boards/shields/lily58_round_display/Kconfig.defconfig

if SHIELD_LILY58_ROUND_DISPLAY

config ZMK_KEYBOARD_NAME
    default "Lily58 Round"

config ZMK_SPLIT_ROLE_CENTRAL
    default y

config ZMK_SPLIT
    default y

if ZMK_DISPLAY

choice ZMK_DISPLAY_WORK_QUEUE
    default ZMK_DISPLAY_WORK_QUEUE_DEDICATED
endchoice

endif # ZMK_DISPLAY

if LVGL

config LV_Z_VDB_SIZE
    default 64

config LV_Z_DPI_DEF
    default 148

config LV_Z_BITS_PER_PIXEL
    default 16

choice LV_COLOR_DEPTH
    default LV_COLOR_DEPTH_16
endchoice

endif # LVGL

endif # SHIELD_LILY58_ROUND_DISPLAY
```

## boards/shields/lily58_round_display/Kconfig.shield
```kconfig
# boards/shields/lily58_round_display/Kconfig.shield

config SHIELD_LILY58_ROUND_DISPLAY
    def_bool $(shields_list_contains,lily58_round_display)
    imply ZMK_DISPLAY
```

## boards/shields/rounded/Kconfig.defconfig
```kconfig
if SHIELD_ROUNDED

if DISPLAY

if LVGL

config LV_Z_BITS_PER_PIXEL
	default 16

endif # LVGL

endif # DISPLAY

endif # SHIELD_ROUNDED
```

## boards/shields/rounded/Kconfig.shield
```kconfig
config SHIELD_ROUNDED
	def_bool $(shields_list_contains,rounded)
	imply ZMK_DISPLAY
```

## boards/shields/rounded_dongle/KConfig.defconfig
```kconfig
if SHIELD_ROUNDED_DONGLE

config ZMK_KEYBOARD_NAME
    default "Round Dongle"

config ZMK_SPLIT
    default y

config ZMK_SPLIT_ROLE_CENTRAL
    default y

config ZMK_DISPLAY
    default y

config ZMK_DISPLAY_STATUS_SCREEN_CUSTOM
    default y

config ROUND_DISPLAY_STATUS
    default y

endif
```

## boards/shields/rounded_dongle/Kconfig.shield
```kconfig
config SHIELD_ROUNDED_DONGLE
    def_bool $(shields_list_contains,rounded_dongle)
```

## config/west.yml
```yaml
manifest:
  defaults:
    revision: v0.3
  remotes:
    - name: zmkfirmware
      url-base: https://github.com/zmkfirmware
    - name: gnomadic
      url-base: https://github.com/gnomadic
  projects:
    - name: zmk
      remote: zmkfirmware
      revision: main
      import: app/west.yml
    - name: zmk-dongle-screen
      remote: gnomadic
      revision: bounding
  self:
    path: config
```

## dts/bindings/display/gc9a01.yaml
```yaml
# dts/bindings/display/gc9a01.yaml
# Device Tree Binding for GC9A01 Round Display

description: GC9A01 240x240 round TFT display

compatible: "gc9a01"

include: ["spi-device.yaml"]

properties:
  width:
    type: int
    required: true
    description: Display width in pixels

  height:
    type: int
    required: true
    description: Display height in pixels

  dc-gpios:
    type: phandle-array
    required: true
    description: Data/Command GPIO pin

  reset-gpios:
    type: phandle-array
    required: false
    description: Reset GPIO pin (optional)

  rotation:
    type: int
    required: false
    default: 0
    enum: [0, 90, 180, 270]
    description: Display rotation in degrees
```

## zephyr/Kconfig
```kconfig
# zephyr/Kconfig
# Round Display Module Configuration

config ZMK_DISPLAY_ROUND
    bool "Enable round display support"
    depends on DISPLAY && SPI
    select DISPLAY_GC9A01
    help
      Enable round display support with GC9A01 driver.

config DISPLAY_GC9A01
    bool "GC9A01 round display driver"
    depends on DISPLAY && SPI
    help
      Enable the GC9A01 round display driver.
```
